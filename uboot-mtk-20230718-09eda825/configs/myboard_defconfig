## uboot-mtk-20230718-09eda825/configs/myboard_defconfig
```kconfig
CONFIG_CMD_DHCPD=y
CONFIG_NET=y
CONFIG_IPADDR=192.168.1.1
CONFIG_SERVERIP=192.168.1.1
CONFIG_NETMASK=255.255.255.0
CONFIG_ETHADDR="00:0a:35:00:1e:51"
CONFIG_BOOTP_SUBNETMASK=y
CONFIG_BOOTP_GATEWAY=y
```

## uboot-mtk-20230718-09eda825/configs/your_board_defconfig
```kconfig
CONFIG_CMD_DHCP=y
CONFIG_CMD_PING=y
CONFIG_CMD_NET=y
CONFIG_NET=y
CONFIG_BOOTP_SUBNETMASK=y
CONFIG_BOOTP_GATEWAY=y
CONFIG_BOOTP_DNS=y
CONFIG_BOOTP_HOSTNAME=y
CONFIG_BOOTP_PXE=y
CONFIG_ETHADDR="00:0a:35:00:1e:51"
CONFIG_IPADDR="192.168.1.100"  /* 回退IP */
CONFIG_SERVERIP="192.168.1.1"
CONFIG_NETMASK="255.255.255.0"
CONFIG_BOOTCOMMAND="run dhcp_boot"
CONFIG_EXTRA_ENV_SETTINGS="dhcp_boot=dhcp; tftp ${loadaddr} ${bootfile}; bootm\0"
```
